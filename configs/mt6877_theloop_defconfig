## drivers/pinctrl/mediatek/Kconfig
```kconfig
if ARCH_MEDIATEK

config PINCTRL_MTK
	depends on PINCTRL_GENERIC
	select REGMAP
	select SYSCON
	bool

config PINCTRL_MT7622
	bool "MT7622 SoC pinctrl driver"
	select PINCTRL_MTK

config PINCTRL_MT7623
	bool "MT7623 SoC pinctrl driver"
	select PINCTRL_MTK

config PINCTRL_MT7629
	bool "MT7629 SoC pinctrl driver"
	select PINCTRL_MTK

config PINCTRL_MT7981
	bool "MT7981 SoC pinctrl driver"
	select PINCTRL_MTK

config PINCTRL_MT7986
	bool "MT7986 SoC pinctrl driver"
	select PINCTRL_MTK

config PINCTRL_MT7987
	bool "MT7987 SoC pinctrl driver"
	select PINCTRL_MTK

config PINCTRL_MT7988
	bool "MT7988 SoC pinctrl driver"
	select PINCTRL_MTK

config PINCTRL_MT8188
	bool "MT8188 SoC pinctrl driver"
	select PINCTRL_MTK

config PINCTRL_MT6877
	bool "MT6877 SoC pinctrl driver (using MT8188 backend as scaffold)"
	select PINCTRL_MTK
	help
	  theloop scaffold: enables the MT8188 pinctrl backend for MT6877
	  target. Pin tables are MT8188's and will NOT produce correct pin
	  muxing on MT6877 hardware — this is a compile-time placeholder so
	  the u-boot scaffold builds. Replace with a native MT6877 pinctrl
	  driver before expecting on-hardware peripherals (eMMC, I2C) to work.

config PINCTRL_MT8195
	bool "MT8195 SoC pinctrl driver"
	select PINCTRL_MTK

config PINCTRL_MT8189
	bool "MT8189 SoC pinctrl driver"
	select PINCTRL_MTK

config PINCTRL_MT8365
	bool "MT8365 SoC pinctrl driver"
	select PINCTRL_MTK

config PINCTRL_MT8512
	bool "MT8512 SoC pinctrl driver"
	select PINCTRL_MTK

config PINCTRL_MT8516
	bool "MT8516 SoC pinctrl driver"
	select PINCTRL_MTK

config PINCTRL_MT8518
        bool "MT8518 SoC pinctrl driver"
	select PINCTRL_MTK

endif
```
